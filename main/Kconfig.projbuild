## main/Kconfig.projbuild
```kconfig
menu "Hardware Configuration"
    choice TARGET_HARDWARE
        prompt "Target Hardware"
        default TARGET_HARDWARE_T3_DONGLE
        help
            Select the target hardware for the example.

        config TARGET_HARDWARE_T3_DONGLE
            depends on IDF_TARGET_ESP32S3
            bool "LilyGo T3 Dongle"

        config TARGET_HARDWARE_QTPY_ESP32_S3
            depends on IDF_TARGET_ESP32S3
            bool "Adafruit QT Py ESP32-S3"

    endchoice
endmenu
```

## sdkconfig.defaults
```kconfig
CONFIG_IDF_TARGET="esp32s3"

CONFIG_FREERTOS_HZ=1000

CONFIG_ESPTOOLPY_FLASHSIZE_4MB=y

# ESP32-specific
#
CONFIG_ESP_DEFAULT_CPU_FREQ_MHZ_240=y
CONFIG_ESP_DEFAULT_CPU_FREQ_MHZ=240

# Common ESP-related
#
CONFIG_ESP_SYSTEM_EVENT_TASK_STACK_SIZE=4096
CONFIG_ESP_MAIN_TASK_STACK_SIZE=8192

# Partition Table
CONFIG_PARTITION_TABLE_CUSTOM=y
CONFIG_PARTITION_TABLE_CUSTOM_FILENAME="partitions.csv"

#
# BT config
#
CONFIG_BT_ENABLED=y
CONFIG_BTDM_CTRL_MODE_BLE_ONLY=y
CONFIG_BTDM_CTRL_MODE_BR_EDR_ONLY=n
CONFIG_BTDM_CTRL_MODE_BTDM=n
CONFIG_BT_BLUEDROID_ENABLED=n
CONFIG_BT_NIMBLE_ENABLED=y
```
